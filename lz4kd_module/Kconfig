## lz4kd_module/Kconfig
```kconfig
config CRYPTO_LZ4KD
	tristate "LZ4KD compression algorithm"
	default y
	select CRYPTO_ALGAPI
	select CRYPTO_SCOMP
	help
	  LZ4KD (LZ4K 4KB page + Delta) compression algorithm for ZRAM.
```
